/{
    split_inputs {
        #address-cells = <1>;
        #size-cells = <0>;

        pointing_device_split: pointing_device_split@0 {
            compatible = "zmk,input-split";
            reg = <0>;
        };
    };

    pointing_device_split_listener: pointing_device_split_listener {
        compatible = "zmk,input-listener";
        device = <&pointing_device_split>;
        status = "okay";
        /* Local側と同じくScrollを先に処理し、Layer 5以外はMouse処理へ渡します。 */
        input-processors = <&split_scroll_runtime_input_processor
                            &split_mouse_runtime_input_processor>;
     };
};
